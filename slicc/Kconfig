## slicc/Kconfig
```kconfig
config PROTOCOL
    default "MESI_unord" if RUBY_MESI_unord
    default "MESI_unord_CXL" if RUBY_MESI_unord_CXL
    default "MESI_CXL_MOESI" if RUBY_MESI_CXL_MOESI
    default "MESI_CXL_MESIF" if RUBY_MESI_CXL_MESIF



cont_choice "Ruby protocol"
    config RUBY_MESI_unord
        bool "MESI_unord"
    config RUBY_MESI_unord_CXL
        bool "MESI_unord_CXL"
    config RUBY_MESI_CXL_MOESI
        bool "MESI_CXL_MOESI"
    config RUBY_MESI_CXL_MESIF
        bool "MESI_CXL_MESIF"
endchoice
```
